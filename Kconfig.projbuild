## Kconfig.projbuild
```kconfig
menu "UBIRCH"

config FIRMWARE_UPGRADE_BASE_URL
    string "Firmware upgrade base URL"
    default "https://fw.prod.ubirch.com"
    help
        Base URL of server which hosts the firmware image.

config FIRMWARE_UPGRADE_FILE
    string "Project Firmware File" if FIRMWARE_FILE_OVERRIDE
    default "dev/firmware.bin"
    help
        File name of the firmware update image.

endmenu
```
